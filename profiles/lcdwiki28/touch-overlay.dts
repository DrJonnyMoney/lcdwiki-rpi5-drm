/dts-v1/;
/plugin/;

/ {
    compatible = "brcm,bcm2712", "brcm,bcm2835";

    fragment@0 {
        target = <&spi0>;
        __overlay__ {
            #address-cells = <1>;
            #size-cells = <0>;

            touchscreen@1 {
                compatible = "ti,ads7846";
                reg = <1>;
                spi-max-frequency = <2000000>;

                interrupt-parent = <&gpio>;
                interrupts = <17 2>;
                pendown-gpio = <&gpio 17 1>;

                ti,x-plate-ohms = /bits/ 16 <60>;
                ti,pressure-max = /bits/ 16 <255>;

                touchscreen-swapped-x-y;
                touchscreen-inverted-y;

                status = "okay";
            };
        };
    };
};
